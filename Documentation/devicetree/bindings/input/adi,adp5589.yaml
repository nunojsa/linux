## Documentation/devicetree/bindings/input/adi,adp5589.yaml
```yaml
# SPDX-License-Identifier: (GPL-2.0-only OR BSD-2-Clause)
%YAML 1.2
---
$id: http://devicetree.org/schemas/input/adi,adp5589.yaml#
$schema: http://devicetree.org/meta-schemas/core.yaml#

title: Analog Devices ADP5589 and similar Keypad Controllers

maintainers:
  - Nuno Sá <nuno.sa@analog.com>
  - Michael Hennerich <michael.hennerich@analog.com>

description: |
  Analog Devices Mobile I/O Expander and QWERTY Keypad Controllers
   - https://www.analog.com/media/en/technical-documentation/data-sheets/ADP5589.pdf
   - https://www.analog.com/media/en/technical-documentation/data-sheets/ADP5585.pdf

properties:
  compatible:
    enum:
      - adi,adp5589
      - adi,adp5585
      - adi,adp5585-2

  reg:
    maxItems: 1

  vcc-supply:
    description: Supply Voltage Input

  interrupts:
    maxItems: 1

  gpio-controller:
    description:
      This property applies if there are pins not used in the keypad.

  '#gpio-cells':
    const: 2

  interrupt-controller:
    description:
      This property applies if there are pins not used in the keypad.

  '#interrupt-cells':
    const: 2

  adi,cols-mask:
    description:
    $ref: /schemas/types.yaml#/definitions/uint32
    minimum:
    maximum:

  adi,row-mask:
    description:
    $ref: /schemas/types.yaml#/definitions/uint32
    minimum:
    maximum:

  adi,key-poll-ms
    description:
    $ref: /schemas/types.yaml#/definitions/uint32
    enum: [10 20 30 40]
    default: 10

  adi,unlock-keys:
    description:
      Specifies a maximum of 2 keys that can be used to unlock the keypad.
      If this property is set, the keyboard will be locked and only unlocked
      after these keys are pressed. The value 127 serves as a wildcard which
      means any key can be used for unlocking.
    $ref: /schemas/types.yaml#/definitions/uint32-array
    minItems: 1
    maxItems: 2

  adi,unlock-trigger-sec:
    description:
    $ref: /schemas/types.yaml#/definitions/uint32
    maximum: 7
    default: 0

  adi,reset1-keys:
    description:
    $ref: /schemas/types.yaml#/definitions/uint32-array
    minItems: 1
    maxItems: 2

  adi,reset2-keys
    description:
    $ref: /schemas/types.yaml#/definitions/uint32-array
    minItems: 1
    maxItems: 2

  adi,reset1-active-high:
    description:
    type: boolean

  adi,reset2-active-high:
    description:
    type: boolean

  adi,rst-passtrough-enable:
    description:
    type: boolean

  adi,reset-trigger-ms:
    description:
    enum: [0 1000 1500 2000 2500 3000 3500 4000]
    default: 0

  adi,reset-pulse-width-us
    description:
    enum: [500 1000 2000 10000]
    default: 500

  '#address-cells':
    const: 1

  '#size-cells':
    const: 0

patternProperties:
  "^gpi0@[0-9]+":

  description:

  properties:
    reg:
      description:
      maximum: 18

    adi,pull-up-ohms:
      description:
      $ref: /schemas/types.yaml#/definitions/uint32
      enum: [100000 300000]
      default: 300000

  required:
      - reg

  allOf:
    - if:
        properties:
          compatible:
            const: adi,adp5585-2
        then:
          reg:
            maximum: 10

    - if:
        properties:
          compatible:
            const: adi,adp5585
        then:
          properties:
            reg:
              enum: [0 1 2 3 4 6 7 8 9 10]

dependencies:
  linux,keymap: [adi,row-mask adi,col-mask]
  adi,unlock-trigger-sec: [adi,unlock-keys]
  adi,reset1-active-high: [adi,reset1-keys]
  adi,rst-passtrough-enable: [adi,reset1-keys]
  adi,reset2-active-high: [adi,reset2-keys]

required:
  - compatible
  - reg
  - vcc-supply

allOf:
  - $ref: matrix-keymap.yaml#
  - $ref: input.yaml#
  - if:
      properties:
        compatible:
          contains:
            enum:
              - adi,adp5585-2
              - adi,adp5585
    then:
      properties:
        adi,unlock-keys: false
        adi,unlock-trigger-sec: false

unevaluatedProperties: false
```
